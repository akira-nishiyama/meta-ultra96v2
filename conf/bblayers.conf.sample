## conf/bblayers.conf.sample
```bitbake
LCONF_VERSION = "7"

BBPATH = "${TOPDIR}"
BBFILES ?= ""

BBLAYERS ?= " \
    ##OEROOT##/meta \
    ##OEROOT##/meta-poky \
    ##OEROOT##/../meta-openembedded/meta-perl \
    ##OEROOT##/../meta-openembedded/meta-python \
    ##OEROOT##/../meta-openembedded/meta-filesystems \
    ##OEROOT##/../meta-openembedded/meta-gnome \
    ##OEROOT##/../meta-openembedded/meta-multimedia \
    ##OEROOT##/../meta-openembedded/meta-networking \
    ##OEROOT##/../meta-openembedded/meta-webserver \
    ##OEROOT##/../meta-openembedded/meta-xfce \
    ##OEROOT##/../meta-openembedded/meta-initramfs \
    ##OEROOT##/../meta-openembedded/meta-oe \
    ##OEROOT##/../meta-browser \
    ##OEROOT##/../meta-qt5 \
    ##OEROOT##/../meta-xilinx/meta-xilinx-bsp \
    ##OEROOT##/../meta-xilinx/meta-xilinx-pynq \
    ##OEROOT##/../meta-xilinx/meta-xilinx-contrib \
    ##OEROOT##/../meta-xilinx-tools \
    ##OEROOT##/../meta-petalinux \
    ##OEROOT##/../meta-virtualization \
    ##OEROOT##/../meta-openamp \
    ##OEROOT##/../meta-jupyter \
    ##OEROOT##/../meta-ultra96v2 \
    ##OEROOT##/../meta-ros/meta-ros-backports-warrior \
    ##OEROOT##/../meta-ros/meta-ros-common \
    ##OEROOT##/../meta-ros/meta-ros2 \
    ##OEROOT##/../meta-ros/meta-ros2-dashing \
"

BBLAYERS_NON_REMOVABLE ?= " \
    ##OEROOT##/meta \
"

ROS_DISTRO_BASELINE_PLATFORM ?= "ubuntu-bionic"
ROS_DISTRO ?= "dashing"
```
